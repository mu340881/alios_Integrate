## board/atbm6431/Config.in
```kconfig
config AOS_BOARD_ATBM6431
    bool "ATBM6431"
    select AOS_MCU_ATBM6431
    select AOS_COMP_KERNEL_INIT
    help
        The ATBM6431 integrates a ANDES 32-bit RISC processor.

if AOS_BOARD_ATBM6431
# Configurations for board atbm6431

config DEBUG_CONFIG_PANIC
    bool "Enable debug panic feature"
    default y
    help
        set to y if you want to enable panic debug feature when system crash happened,
        default y

config DEBUG_CONFIG_BACKTRACE
    bool "Enable stack backtrace feature"
    default y
    help
        set to y if you want to enable stack backtrace feature when system crash happened,
        default y

# "BSP SUPPORT FEATURE"
config BSP_SUPPORT_UART
    bool
    default y

config BSP_SUPPORT_GPIO
    bool
    default y

config BSP_SUPPORT_FLASH
    bool
    default y



endif
```

## platform/arch/andes/N9/Config.in
```kconfig
config AOS_ARCH_ANDES_N9
    bool
    help
      arch for andes N9

if AOS_ARCH_ANDES_N9
# Configurations for arch andes N9
endif
```

## platform/mcu/atbm6431/Config.in
```kconfig
config AOS_MCU_ATBM6431
    bool
    select AOS_COMP_LWIP
    select AOS_ATBM_COMP_LWIP
    select AOS_COMP_ALICRYPTO
    select AOS_COMP_NETMGR
    select AOS_COMP_RHINO if OSAL_CONFIG = rhino
    select AOS_COMP_YLOOP
    select AOS_COMP_DEBUG
    select AOS_ARCH_ANDES_N9 if OSAL_CONFIG = rhino
    help
      driver & sdk for platform/mcu atbm6431

if AOS_MCU_ATBM6431
# Configurations for mcu atbm6431

config OSAL_CONFIG
    string
    default rhino

endif
```
